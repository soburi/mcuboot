## boot/zephyr/boards/nrf52840_pca10056.conf
```kconfig
CONFIG_UART_CONSOLE=n
CONFIG_USE_SEGGER_RTT=y
CONFIG_LOG_BACKEND_RTT=y
CONFIG_BOOT_SERIAL_UART=y

# The build won't fit on the partition allocated for it without size
# optimizations.
#CONFIG_SIZE_OPTIMIZATIONS=y

# Serial
CONFIG_SERIAL=y
CONFIG_UART_NRFX=y
#CONFIG_BOOT_SERIAL_CDC_ACM=y
CONFIG_UART_INTERRUPT_DRIVEN=y
CONFIG_UART_LINE_CTRL=y

# MCUBoot serial
CONFIG_GPIO=y
CONFIG_MCUBOOT_SERIAL=y
CONFIG_BOOT_SERIAL_DETECT_PORT="GPIO_0"
CONFIG_BOOT_SERIAL_DETECT_PIN=11

# Required by USB
CONFIG_MULTITHREADING=y
```
